## Config.in
```kconfig
source "$BR2_EXTERNAL_HDFPV_PATH/package/hdfpv/Config.in"
source "$BR2_EXTERNAL_HDFPV_PATH/package/openvgadapt/Config.in"
source "$BR2_EXTERNAL_HDFPV_PATH/package/raspi2png/Config.in"
```

## configs/hdfpv_rpi2_defconfig
```kconfig
BR2_arm=y
BR2_cortex_a7=y
BR2_ARM_EABIHF=y
BR2_ARM_FPU_NEON_VFPV4=y

BR2_TOOLCHAIN_BUILDROOT_CXX=y

BR2_SYSTEM_DHCP="eth0"

# Linux headers same as kernel, a 4.9 series
BR2_PACKAGE_HOST_LINUX_HEADERS_CUSTOM_4_9=y

BR2_LINUX_KERNEL=y
BR2_LINUX_KERNEL_CUSTOM_GIT=y
BR2_LINUX_KERNEL_CUSTOM_REPO_URL="https://github.com/zygmunt/linux.rpi.git"
BR2_LINUX_KERNEL_CUSTOM_REPO_VERSION="470e4d73052a902dd85393521a63d77613d1b4e1"
BR2_LINUX_KERNEL_DEFCONFIG="bcm2709"

# Build the DTB from the kernel sources
BR2_LINUX_KERNEL_DTS_SUPPORT=y
BR2_LINUX_KERNEL_INTREE_DTS_NAME="bcm2709-rpi-2-b"

BR2_PACKAGE_RPI_FIRMWARE=y
# BR2_PACKAGE_RPI_FIRMWARE_INSTALL_DTB_OVERLAYS is not set

# Required tools to create the SD image
BR2_PACKAGE_HOST_DOSFSTOOLS=y
BR2_PACKAGE_HOST_GENIMAGE=y
BR2_PACKAGE_HOST_MTOOLS=y

# Filesystem / image
BR2_TARGET_ROOTFS_EXT2=y
BR2_TARGET_ROOTFS_EXT2_4=y
# BR2_TARGET_ROOTFS_TAR is not set

# HDFPV board
BR2_ROOTFS_POST_BUILD_SCRIPT="$(BR2_EXTERNAL_HDFPV_PATH)/board/raspberrypi2/post-build.sh"
BR2_ROOTFS_POST_IMAGE_SCRIPT="$(BR2_EXTERNAL_HDFPV_PATH)/board/raspberrypi2/post-image.sh"

# HDFPV
BR2_PACKAGE_HDFPV=y
BR2_TARGET_GENERIC_HOSTNAME="hdfpv"
BR2_TARGET_GENERIC_ISSUE="Welcome to hdfpv"
BR2_TARGET_GENERIC_ROOT_PASSWD="root"
BR2_TARGET_ROOTFS_EXT2_SIZE=100M
```

## package/hdfpv/Config.in
```kconfig
config BR2_PACKAGE_HDFPV
    bool "hdfpv"
    #depends on BR2_PACKAGE_RPI_FIRMWARE BR2_PACKAGE_RPI_FIRMWARE_X BR2_RPI_USERLAND BR2_RPI_USERLAND_HELLO
    select BR2_PACKAGE_BUSYBOX_SHOW_OTHERS
    select BR2_PACKAGE_RPI_FIRMWARE 
    select BR2_PACKAGE_RPI_FIRMWARE_X 
    select BR2_PACKAGE_RPI_USERLAND 
    select BR2_PACKAGE_RPI_USERLAND_HELLO
    select BR2_PACKAGE_IPROUTE2
    select BR2_PACKAGE_IW
    select BR2_PACKAGE_WIRELESS_TOOLS
    select BR2_PACKAGE_NET_TOOLS
    select BR2_PACKAGE_LIBPCAP
    select BR2_PACKAGE_OPENVGADAPT
    select BR2_PACKAGE_RASPI2PNG
    select BR2_PACKAGE_BASH
    select BR2_PACKAGE_LINUX_FIRMWARE
    select BR2_PACKAGE_LINUX_FIRMWARE_ATHEROS_9271
    select BR2_PACKAGE_LINUX_FIRMWARE_RALINK_RT2XX
    select BR2_PACKAGE_DOS2UNIX
    help
        hdfpv makes things easy with buildroot

        http://zygmuntptak.pl/hdfpv
```

## package/openvgadapt/Config.in
```kconfig
config BR2_PACKAGE_OPENVGADAPT
    bool "openvgadapt"
    select BR2_PACKAGE_RPI_USERLAND 
    select BR2_PACKAGE_RPI_USERLAND_HELLO
    select BR2_PACKAGE_JPEG
    help
        Testbed for exploring OpenVG on the Raspberry Pi.
        https://github.com/zygmunt/openvgadapt for of https://github.com/ajstarks/openvg

        https://github.com/ajstarks/openvg
 
```

## package/raspi2png/Config.in
```kconfig
config BR2_PACKAGE_RASPI2PNG
    bool "raspi2png"
    select BR2_PACKAGE_RPI_USERLAND 
    select BR2_PACKAGE_RPI_USERLAND_HELLO
    select BR2_PACKAGE_LIBPNG
    help
        Utility to take a snapshot of the raspberry pi screen and save it as a PNG file
        https://github.com/zygmunt/raspi2png for of https://github.com/AndrewFromMelbourne/raspi2png

        https://github.com/AndrewFromMelbourne/raspi2png
 
```
